## main/Kconfig.projbuild
```kconfig
menu "App WiFi settings"

config WIFI_SSID
    string "WiFi SSID"
    default "esp32"
    help
		SSID (network name) for the example to connect to

config WIFI_PASS
    string "WiFi Password"
    default "12345678"
    help
		WiFi password (WPA2) for the example to use

config WIFI_CONN_MAX_RETRIES
	int "Max connect attempts"
	range 0 20
	default 5
	help
		The maximum number of attempts to connect to Wi-Fi

choice WIFI_SCAN_AUTH_MODE_THRESHOLD
	prompt "WiFi Scan auth mode threshold"
	default WIFI_AUTH_WPA2_PSK
	help
		The weakest authmode to accept in the scan mode.
 
	config WIFI_AUTH_OPEN
		bool "OPEN"
	config WIFI_AUTH_WEP
		bool "WEP"
	config WIFI_AUTH_WPA_PSK
		bool "WPA PSK"
	config WIFI_AUTH_WPA2_PSK
		bool "WPA2 PSK"
	config WIFI_AUTH_WPA_WPA2_PSK
		bool "WPA WPA2 PSK"
	config WIFI_AUTH_WPA2_ENTERPRISE
		bool "WPA2 ENTERPRISE"
	config WIFI_AUTH_WPA3_PSK
		bool "WPA3 PSK"
	config WIFI_AUTH_WPA2_WPA3_PSK
		bool "WPA2 WPA3 PSK"
	config WIFI_AUTH_WAPI_PSK
		bool "WAPI PSK"
endchoice

endmenu

menu "App HTTP server settings"
	
config HTTP_PORT
    int "Server Port"
    range 0 65535
    default 80
    help
    	The http server port.

endmenu
```
